## bsp/esp32_p4_jc4880/main/Kconfig.projbuild
```kconfig
menu "CBDos Product & Build Profile"

choice CBDOS_PRODUCT_FAMILY
    prompt "Product Family"
    default CBDOS_PRODUCT_CYBERDECK

config CBDOS_PRODUCT_CYBERDECK
    bool "CBDos Cyberdeck"

config CBDOS_PRODUCT_TABLEHUB
    bool "TableHub Hospitality Appliance"
endchoice

if CBDOS_PRODUCT_CYBERDECK
    choice CBDOS_CYBERDECK_PROFILE
        prompt "Cyberdeck Variant"
        default CBDOS_PROFILE_FULL

    config CBDOS_PROFILE_FULL
        bool "Full Cyberdeck Suite (All Apps, Tools, Flasher, TTS)"

    config CBDOS_PROFILE_LITE
        bool "Lite Profile (Slim Footprint)"
    endchoice

    config CBDOS_FEATURE_SDR
        bool "SDR Radio Companion Suite (ESP-SDR over USB Host CDC)"
        default y if CBDOS_PROFILE_FULL
        default n
        help
            Habilita el subsistema de radio definida por software (SDR),
            los comandos de consola 'sdr' y la aplicación analizadora de espectro.
endif

if CBDOS_PRODUCT_TABLEHUB
    choice TABLEHUB_DEVICE_MODE
        prompt "TableHub Operating Mode"
        default TABLEHUB_MODE_KDS

    config TABLEHUB_MODE_KDS
        bool "KDS - Kitchen Display System (Full Kitchen Dashboard)"

    config TABLEHUB_MODE_TABLETOP
        bool "Tabletop - Guest Dining Terminal (Order & Service Screen)"
    endchoice
endif

endmenu
```

## bsp/esp32_p4_jc4880/sdkconfig.defaults
```kconfig
# Target ESP32-P4
CONFIG_IDF_TARGET="esp32p4"
CONFIG_IDF_TARGET_ESP32P4=y
CONFIG_ESP32P4_SELECTS_REV_LESS_V3=y

# CPU & Frequency (400 MHz Dual Core)
CONFIG_ESP_DEFAULT_CPU_FREQ_MHZ_400=y
CONFIG_ESP_DEFAULT_CPU_FREQ_MHZ=400
CONFIG_ESP_CONSOLE_USB_SERIAL_JTAG=y
CONFIG_ESP_MAIN_TASK_STACK_SIZE=16384


# PSRAM (Octal/Hexal 200 MHz)
CONFIG_SPIRAM=y
CONFIG_SPIRAM_MODE_OCT=y
CONFIG_SPIRAM_SPEED_200M=y
CONFIG_SPIRAM_BOOT_INIT=y
CONFIG_SPIRAM_USE_MALLOC=y
CONFIG_SPIRAM_MEMTEST=n

# FreeRTOS 1000 Hz tick rate
CONFIG_FREERTOS_HZ=1000

# Flash 16MB
CONFIG_ESPTOOLPY_FLASHSIZE_16MB=y
CONFIG_ESPTOOLPY_FLASHSIZE="16MB"
CONFIG_PARTITION_TABLE_CUSTOM=y
CONFIG_PARTITION_TABLE_CUSTOM_FILENAME="partitions.csv"

# LVGL 9 Configuration
CONFIG_LV_COLOR_DEPTH_16=y
CONFIG_LV_COLOR_16_SWAP=n
CONFIG_LV_USE_CLIB_MALLOC=y
CONFIG_LV_USE_CLIB_STRING=y
CONFIG_LV_USE_CLIB_SPRINTF=y
CONFIG_LV_USE_BUILTIN_MALLOC=n
CONFIG_LV_CACHE_DEF_SIZE=2097152
CONFIG_LV_USE_PERF_MONITOR=n
CONFIG_LV_USE_MEM_MONITOR=n
CONFIG_LV_USE_LOG=y
CONFIG_LV_LOG_LEVEL_WARN=y
CONFIG_LV_FONT_MONTSERRAT_12=y
CONFIG_LV_FONT_MONTSERRAT_14=y
CONFIG_LV_FONT_MONTSERRAT_16=y
CONFIG_LV_FONT_MONTSERRAT_18=y
CONFIG_LV_FONT_MONTSERRAT_20=y
CONFIG_LV_FONT_MONTSERRAT_24=y

# LVGL 9 Image Decoders & File System
CONFIG_LV_USE_BMP=y
CONFIG_LV_USE_TJPGD=y
CONFIG_LV_USE_LODEPNG=y
CONFIG_LV_USE_GIF=y
CONFIG_LV_USE_FS_POSIX=y
CONFIG_LV_FS_POSIX_LETTER=65
CONFIG_LV_FS_POSIX_PATH="/sdcard"

# LVGL 9 Vector Graphics & Lottie (ThorVG)
CONFIG_LV_USE_VECTOR_GRAPHIC=y
CONFIG_LV_USE_THORVG=y
CONFIG_LV_USE_THORVG_INTERNAL=y
CONFIG_LV_USE_LOTTIE=y
CONFIG_LV_USE_CANVAS=y

# FatFS exFAT Support (Tarjetas de 64GB, 128GB, 256GB SDXC)
CONFIG_FATFS_EXFAT=y

# MIPI-DSI & PPA 2D Accelerator
CONFIG_ESP_LCD_DSI_COLOR_RGB565=y
CONFIG_ESP_LVGL_PORT_PPA_ACCELERATION=y

# FatFS & Long File Names (LFN)
CONFIG_FATFS_LFN_HEAP=y
CONFIG_FATFS_MAX_LFN=255
CONFIG_FATFS_SECTOR_4096=y
CONFIG_FATFS_PER_FILE_CACHE=y
CONFIG_FATFS_ALLOC_PREFER_EXTRAM=y

# Wi-Fi Remote & ESP-Hosted SDIO (ESP32-C6 Slave)
CONFIG_ESP_WIFI_REMOTE_ENABLED=y
CONFIG_ESP_WIFI_REMOTE_LIBRARY_HOSTED=y
CONFIG_ESP_HOSTED_ENABLED=y
CONFIG_ESP_HOSTED_SDIO_HOST_INTERFACE=y
CONFIG_ESP_HOSTED_IDF_SLAVE_TARGET="esp32c6"
CONFIG_ESP_HOSTED_SDIO_4_BIT_BUS=y
CONFIG_ESP_HOSTED_SDIO_CLOCK_FREQ_KHZ=20000
CONFIG_ESP_HOSTED_SDIO_PIN_CLK=18
CONFIG_ESP_HOSTED_SDIO_PIN_CMD=19
CONFIG_ESP_HOSTED_SDIO_PIN_D0=14
CONFIG_ESP_HOSTED_SDIO_PIN_D1=15
CONFIG_ESP_HOSTED_SDIO_PIN_D2=16
CONFIG_ESP_HOSTED_SDIO_PIN_D3=17
CONFIG_ESP_HOSTED_SDIO_GPIO_RESET_SLAVE=54
CONFIG_ESP_HOSTED_GPIO_SLAVE_RESET_SLAVE=54

# ESP Serial Flasher
CONFIG_SERIAL_FLASHER_INTERFACE_UART=y
CONFIG_SERIAL_FLASHER_MD5_ENABLED=y

# SPIFFS Storage
CONFIG_SPIFFS_SUPPORT=y
CONFIG_SPIFFS_MAX_PARTITIONS=3
CONFIG_SPIFFS_PAGE_SIZE=256
CONFIG_SPIFFS_OBJ_NAME_LEN=32

# TinyUSB Device & HID (High-Speed OTG Port)
CONFIG_TINYUSB_HID_COUNT=1
CONFIG_TINYUSB_RHPORT_HS=y
# CONFIG_TINYUSB_RHPORT_FS is not set
```

## tools/c6_flasher_bridge/sdkconfig.defaults
```kconfig
CONFIG_IDF_TARGET="esp32p4"
CONFIG_IDF_TARGET_ESP32P4=y
CONFIG_ESP32P4_SELECTS_REV_LESS_V3=y
CONFIG_ESP_DEFAULT_CPU_FREQ_MHZ_400=y
CONFIG_ESP_DEFAULT_CPU_FREQ_MHZ=400
CONFIG_ESP_CONSOLE_NONE=y
CONFIG_ESP_CONSOLE_SECONDARY_NONE=y
CONFIG_FREERTOS_HZ=1000
CONFIG_ESPTOOLPY_FLASHSIZE_16MB=y
CONFIG_ESPTOOLPY_FLASHSIZE="16MB"
```
